## conf/layer.conf
```bitbake
# We have a conf and classes directory, add to BBPATH
BBPATH .= ":${LAYERDIR}"

# We have recipes-* directories, add to BBFILES
BBFILES += "${LAYERDIR}/recipes-*/*/*.bb \
	${LAYERDIR}/recipes-*/*/*.bbappend"

BBFILE_COLLECTIONS += "cqpub-rpi3-fan"
BBFILE_PATTERN_cqpub-rpi3-fan = "^${LAYERDIR}/"
BBFILE_PRIORITY_cqpub-rpi3-fan = "11"

LAYERDEPENDS_rpi3-aarch64 = "core \
			     openembedded-layer \
			     raspberrypi \
			     rpi3-bt-support \
			     hdmi5inch-rpi"
```
